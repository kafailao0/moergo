/*
 * Copyright (c) 2020 The ZMK Contributors
 * Copyright (c) 2025 Innaworks Development Limited, trading as MoErgo
 *
 * SPDX-License-Identifier: MIT
 */
/* THIS FILE WAS GENERATED BY GLOVE80 LAYOUT EDITOR
 *
 * This file was generated automatically. You may or may not want to
 * edit it directly.
 */
/* Include all behavior includes needed */

#include <behaviors.dtsi>
#include <dt-bindings/zmk/bt.h>
#include <dt-bindings/zmk/keys.h>
#include <dt-bindings/zmk/outputs.h>
#include <dt-bindings/zmk/rgb.h>
#include <dt-bindings/zmk/rgb_colors.h>
#define ZMK_POINTING_DEFAULT_MOVE_VAL 2000
#define ZMK_POINTING_DEFAULT_SCRL_VAL 20
#include <dt-bindings/zmk/pointing.h>

#define SNIPER_MOVE_VAL 500
#define SNIPER_SCRL_VAL 5

#define SNIPER_MOVE_UP    MOVE_Y(-SNIPER_MOVE_VAL)
#define SNIPER_MOVE_DOWN  MOVE_Y(SNIPER_MOVE_VAL)
#define SNIPER_MOVE_LEFT  MOVE_X(-SNIPER_MOVE_VAL)
#define SNIPER_MOVE_RIGHT MOVE_X(SNIPER_MOVE_VAL)

#define SNIPER_SCRL_UP    MOVE_Y(SNIPER_SCRL_VAL)
#define SNIPER_SCRL_DOWN  MOVE_Y(-SNIPER_SCRL_VAL)
#define SNIPER_SCRL_LEFT  MOVE_X(-SNIPER_SCRL_VAL)
#define SNIPER_SCRL_RIGHT MOVE_X(SNIPER_SCRL_VAL)

/* On demand includes */
/* Helper Macros, based on https://github.com/urob/zmk-helpers/ */

#pragma once

#define ZMK_HELPER_STRINGIFY(x) #x

// Preprocessor mechanism to overload macros, cf. https://stackoverflow.com/a/27051616/6114651

#define VARGS_(_10, _9, _8, _7, _6, _5, _4, _3, _2, _1, N, ...) N
#define VARGS(...) VARGS_(__VA_ARGS__, 10, 9, 8, 7, 6, 5, 4, 3, 2, 1, 0)
#define CONCAT_(a, b) a##b
#define CONCAT(a, b) CONCAT_(a, b)

#define ZMK_BEHAVIOR_CORE_tap_dance  \
    compatible = "zmk,behavior-tap-dance"; \
    #binding-cells = <0>

#define ZMK_BEHAVIOR(name, type, ...) \
    name: name { \
        ZMK_BEHAVIOR_CORE_ ## type; \
        __VA_ARGS__ \
    };
#define ZMK_TAP_DANCE(name, ...) \
    ZMK_BEHAVIOR(name, tap_dance, __VA_ARGS__)
#define ZMK_TD_LAYER(name, layer) \
    ZMK_TAP_DANCE(name, \
        tapping-term-ms = <200>; \
        bindings = <&mo layer>, <&tog layer>; \
)

/* Environment and metadata defines */

#define KB_TYPE_GLOVE_80 1
#define KB_TYPE_GO_60    2
#define KB_TYPE          KB_TYPE_GLOVE_80
#define EDITOR_HOST_OS   'M'

/* Automatically generated layer name defines */

#define LAYER_Base 0
#define LAYER_PC 1
#define LAYER_Gaming 2
#define LAYER_SymbolNav 3
#define LAYER_Keypad 4
#define LAYER_NumRow 5
#define LAYER_Magic 6
#define LAYER_Factory 7
#define LAYER_Mouse 8
#define LAYER_Sniper 9

/* To deal with the situation where there is no Lower layer, to keep &lower happy */

#ifndef LAYER_Lower
#define LAYER_Lower LAYER_Keypad
#endif

/ {
    /* Custom Device-tree */
    /* Input Listeners */
    /* System behavior and Macros */

    behaviors {
        ZMK_TD_LAYER(lower, LAYER_Lower)
    };
};

/ {
    macros {
        rgb_ug_status_macro: rgb_ug_status_macro {
            label = "RGB_UG_STATUS";
            compatible = "zmk,behavior-macro";
            #binding-cells = <0>;
            bindings = <&rgb_ug RGB_STATUS>;
        };
    };
};

/ {
    #ifdef BT_DISC_CMD

    behaviors {
        bt_0: bt_0 {
            compatible = "zmk,behavior-tap-dance";
            label = "BT_0";
            #binding-cells = <0>;
            tapping-term-ms = <200>;
            bindings = <&bt_select_0>, <&bt BT_DISC 0>;
        };

        bt_1: bt_1 {
            compatible = "zmk,behavior-tap-dance";
            label = "BT_1";
            #binding-cells = <0>;
            tapping-term-ms = <200>;
            bindings = <&bt_select_1>, <&bt BT_DISC 1>;
        };

        bt_2: bt_2 {
            compatible = "zmk,behavior-tap-dance";
            label = "BT_2";
            #binding-cells = <0>;
            tapping-term-ms = <200>;
            bindings = <&bt_select_2>, <&bt BT_DISC 2>;
        };

        bt_3: bt_3 {
            compatible = "zmk,behavior-tap-dance";
            label = "BT_3";
            #binding-cells = <0>;
            tapping-term-ms = <200>;
            bindings = <&bt_select_3>, <&bt BT_DISC 3>;
        };
    };

    macros {
        bt_select_0: bt_select_0 {
            label = "BT_SELECT_0";
            compatible = "zmk,behavior-macro";
            #binding-cells = <0>;
            bindings = <&out OUT_BLE &bt BT_SEL 0 &to LAYER_Base>;
        };

        bt_select_1: bt_select_1 {
            label = "BT_SELECT_1";
            compatible = "zmk,behavior-macro";
            #binding-cells = <0>;
            bindings = <&out OUT_BLE &bt BT_SEL 1 &to LAYER_PC>;
        };

        bt_select_2: bt_select_2 {
            label = "BT_SELECT_2";
            compatible = "zmk,behavior-macro";
            #binding-cells = <0>;
            bindings = <&out OUT_BLE &bt BT_SEL 2>;
        };

        bt_select_3: bt_select_3 {
            label = "BT_SELECT_3";
            compatible = "zmk,behavior-macro";
            #binding-cells = <0>;
            bindings = <&out OUT_BLE &bt BT_SEL 3>;
        };
    };

    #else

    macros {
        bt_0: bt_0 {
            label = "BT_0";
            compatible = "zmk,behavior-macro";
            #binding-cells = <0>;
            bindings = <&out OUT_BLE &bt BT_SEL 0 &to LAYER_Base>;
        };

        bt_1: bt_1 {
            label = "BT_1";
            compatible = "zmk,behavior-macro";
            #binding-cells = <0>;
            bindings = <&out OUT_BLE &bt BT_SEL 1 &to LAYER_PC>;
        };

        bt_2: bt_2 {
            label = "BT_2";
            compatible = "zmk,behavior-macro";
            #binding-cells = <0>;
            bindings = <&out OUT_BLE &bt BT_SEL 2>;
        };

        bt_3: bt_3 {
            label = "BT_3";
            compatible = "zmk,behavior-macro";
            #binding-cells = <0>;
            bindings = <&out OUT_BLE &bt BT_SEL 3>;
        };
    };

    #endif
};

/ {
    behaviors {
        magic: magic {
            compatible = "zmk,behavior-hold-tap";
            label = "MAGIC_HOLD_TAP";
            #binding-cells = <2>;
            flavor = "tap-preferred";
            tapping-term-ms = <200>;
            bindings = <&mo>, <&rgb_ug_status_macro>;
        };
    };
};

/* Key positions */

#define POS_LH_C6R1 0
#define POS_LH_C5R1 1
#define POS_LH_C4R1 2
#define POS_LH_C3R1 3
#define POS_LH_C2R1 4
#define POS_RH_C2R1 5
#define POS_RH_C3R1 6
#define POS_RH_C4R1 7
#define POS_RH_C5R1 8
#define POS_RH_C6R1 9
#define POS_LH_C6R2 10
#define POS_LH_C5R2 11
#define POS_LH_C4R2 12
#define POS_LH_C3R2 13
#define POS_LH_C2R2 14
#define POS_LH_C1R2 15
#define POS_RH_C1R2 16
#define POS_RH_C2R2 17
#define POS_RH_C3R2 18
#define POS_RH_C4R2 19
#define POS_RH_C5R2 20
#define POS_RH_C6R2 21
#define POS_LH_C6R3 22
#define POS_LH_C5R3 23
#define POS_LH_C4R3 24
#define POS_LH_C3R3 25
#define POS_LH_C2R3 26
#define POS_LH_C1R3 27
#define POS_RH_C1R3 28
#define POS_RH_C2R3 29
#define POS_RH_C3R3 30
#define POS_RH_C4R3 31
#define POS_RH_C5R3 32
#define POS_RH_C6R3 33
#define POS_LH_C6R4 34
#define POS_LH_C5R4 35
#define POS_LH_C4R4 36
#define POS_LH_C3R4 37
#define POS_LH_C2R4 38
#define POS_LH_C1R4 39
#define POS_RH_C1R4 40
#define POS_RH_C2R4 41
#define POS_RH_C3R4 42
#define POS_RH_C4R4 43
#define POS_RH_C5R4 44
#define POS_RH_C6R4 45
#define POS_LH_C6R5 46
#define POS_LH_C5R5 47
#define POS_LH_C4R5 48
#define POS_LH_C3R5 49
#define POS_LH_C2R5 50
#define POS_LH_C1R5 51
#define POS_LH_T1 52
#define POS_LH_T2 53
#define POS_LH_T3 54
#define POS_RH_T3 55
#define POS_RH_T2 56
#define POS_RH_T1 57
#define POS_RH_C1R5 58
#define POS_RH_C2R5 59
#define POS_RH_C3R5 60
#define POS_RH_C4R5 61
#define POS_RH_C5R5 62
#define POS_RH_C6R5 63
#define POS_LH_C6R6 64
#define POS_LH_C5R6 65
#define POS_LH_C4R6 66
#define POS_LH_C3R6 67
#define POS_LH_C2R6 68
#define POS_LH_T4 69
#define POS_LH_T5 70
#define POS_LH_T6 71
#define POS_RH_T6 72
#define POS_RH_T5 73
#define POS_RH_T4 74
#define POS_RH_C2R6 75
#define POS_RH_C3R6 76
#define POS_RH_C4R6 77
#define POS_RH_C5R6 78
#define POS_RH_C6R6 79

/* Custom Defined Behaviors */

/ {
};

/* Generated input processors */
/* Automatically generated macro definitions */

/ {
    macros {
    };
};

/* Automatically generated behavior definitions */

/ {
    behaviors {
        // home_row_mod_left

        hml: hml {
            compatible = "zmk,behavior-hold-tap";
            #binding-cells = <2>;
            tapping-term-ms = <280>;
            bindings = <&kp>, <&kp>;

            flavor = "balanced";
            quick-tap-ms = <250>;
            require-prior-idle-ms = <150>;
            hold-trigger-key-positions = <POS_RH_C2R1 POS_RH_C3R1 POS_RH_C4R1 POS_RH_C5R1 POS_RH_C6R1 POS_RH_C1R2 POS_RH_C2R2 POS_RH_C3R2 POS_RH_C4R2 POS_RH_C5R2 POS_RH_C6R2 POS_RH_C1R3 POS_RH_C2R3 POS_RH_C3R3 POS_RH_C4R3 POS_RH_C5R3 POS_RH_C6R3 POS_RH_C2R4 POS_RH_C3R4 POS_RH_C4R4 POS_RH_C5R4 POS_RH_C6R4 POS_RH_C2R5 POS_RH_C3R5 POS_RH_C4R5 POS_RH_C5R5 POS_RH_C6R5 POS_RH_C3R6 POS_RH_C4R6 POS_RH_C5R6 POS_RH_C6R6 POS_RH_C1R4 POS_RH_C1R5 POS_RH_C2R6 POS_RH_T3 POS_RH_T2 POS_RH_T1 POS_RH_T6 POS_RH_T5 POS_RH_T4>;
            hold-trigger-on-release;
        };

        // home_row_mod_right

        hmr: hmr {
            compatible = "zmk,behavior-hold-tap";
            #binding-cells = <2>;
            tapping-term-ms = <280>;
            bindings = <&kp>, <&kp>;

            flavor = "balanced";
            quick-tap-ms = <250>;
            require-prior-idle-ms = <150>;
            hold-trigger-key-positions = <POS_LH_C6R1 POS_LH_C5R1 POS_LH_C4R1 POS_LH_C3R1 POS_LH_C2R1 POS_LH_C6R2 POS_LH_C5R2 POS_LH_C4R2 POS_LH_C3R2 POS_LH_C2R2 POS_LH_C1R2 POS_LH_C6R3 POS_LH_C5R3 POS_LH_C4R3 POS_LH_C3R3 POS_LH_C2R3 POS_LH_C1R3 POS_LH_C6R4 POS_LH_C5R4 POS_LH_C4R4 POS_LH_C3R4 POS_LH_C2R4 POS_LH_C1R4 POS_LH_C6R5 POS_LH_C5R5 POS_LH_C4R5 POS_LH_C3R5 POS_LH_C2R5 POS_LH_C1R5 POS_LH_T1 POS_LH_T2 POS_LH_T3 POS_LH_C6R6 POS_LH_C5R6 POS_LH_C4R6 POS_LH_C3R6 POS_LH_C2R6 POS_LH_T4 POS_LH_T5 POS_LH_T6>;
            hold-trigger-on-release;
        };

        hold_tap_layer: hold_tap_layer {
            compatible = "zmk,behavior-hold-tap";
            #binding-cells = <2>;
            tapping-term-ms = <200>;
            bindings = <&mo>, <&kp>;

            flavor = "tap-preferred";
            quick-tap-ms = <175>;
        };

        lt_bspc: lt_bspc {
            compatible = "zmk,behavior-hold-tap";
            #binding-cells = <2>;
            tapping-term-ms = <200>;
            bindings = <&mo>, <&kp>;

            flavor = "tap-preferred";
            quick-tap-ms = <175>;
        };

        lt_tab: lt_tab {
            compatible = "zmk,behavior-hold-tap";
            #binding-cells = <2>;
            tapping-term-ms = <280>;
            flavor = "tap-preferred";
            quick-tap-ms = <175>;
            retro-tap;
            bindings = <&mo>, <&kp>;
        };

        td_caps: td_caps {
            compatible = "zmk,behavior-tap-dance";
            label = "TD_CAPS";
            #binding-cells = <0>;
            tapping-term-ms = <250>;
            bindings = <&caps_word>, <&kp CAPS>;
        };

        ZMK_TD_LAYER(td_LAYER_Keypad, LAYER_Keypad)
    };
};

/* Automatically generated combos definitions */

/ {
    combos {
        compatible = "zmk,combos";
    };
};

/* Automatically generated keymap */

/ {
    keymap {
        compatible = "zmk,keymap";

        layer_Base {
            bindings = <
&kp F1                &kp F2       &kp F3       &kp F4        &kp F5                                                                                                                                             &kp F6        &kp F7        &kp F8       &kp F9          &kp F10
&magic LAYER_Magic 0  &kp N1       &kp N2       &kp N3        &kp N4        &kp N5                                                                                                                       &kp N6  &kp N7        &kp N8        &kp N9       &kp N0          &kp DEL
&kp LS(MINUS)         &kp Q        &kp W        &kp E         &kp R         &kp T                                                                                                                        &kp Y   &kp U         &kp I         &kp O        &kp P           &td_caps
&kp ESC               &hml LGUI A  &hml LALT S  &hml LCTRL D  &hml LSHFT F  &kp G                                                                                                                        &kp H   &hmr RSHFT J  &hmr RCTRL K  &hmr RALT L  &hmr RGUI SEMI  &kp SQT
&kp MINUS             &kp Z        &kp X        &kp C         &kp V         &kp B   &kp LCTRL  &kp LALT                   &kp LGUI                 &kp RGUI  &kp RALT                             &kp RCTRL  &kp N   &kp M         &kp COMMA     &kp DOT      &kp FSLH        &td_LAYER_Keypad
&kp LG(SPACE)         &kp LG(Z)    &kp LG(X)    &kp LG(C)     &kp LG(V)             &kp LSHFT  &lt_bspc LAYER_Mouse BSPC  &lt LAYER_NumRow TAB     &kp RET   &hold_tap_layer LAYER_SymbolNav ESC  &kp SPACE          &kp LEFT      &kp DOWN      &kp UP       &kp RIGHT       &kp GLOBE
            >;
        };

        layer_PC {
            bindings = <
&trans  &trans     &trans     &trans     &trans                                                                                                           &trans  &trans  &trans  &trans  &trans
&trans  &trans     &trans     &trans     &trans     &trans                                                                                        &trans  &trans  &trans  &trans  &trans  &trans
&trans  &trans     &trans     &trans     &trans     &trans                                                                                        &trans  &trans  &trans  &trans  &trans  &trans
&trans  &trans     &trans     &trans     &trans     &trans                                                                                        &trans  &trans  &trans  &trans  &trans  &trans
&trans  &trans     &trans     &trans     &trans     &trans  &trans  &trans  &trans    &trans  &trans  &trans  &trans  &trans  &trans  &trans  &trans      &trans
&trans  &kp LC(Z)  &kp LC(X)  &kp LC(C)  &kp LC(V)          &trans  &trans  &trans    &trans  &trans  &trans          &trans  &trans  &trans  &trans      &trans
            >;
        };

        layer_Gaming {
            bindings = <
&trans    &trans  &trans    &trans     &trans                                                                                                                               &trans  &trans  &trans  &trans    &trans
&trans    &trans  &trans    &trans     &trans                   &trans                                                                                              &trans  &trans  &trans  &trans  &trans    &trans
&kp TAB   &trans  &trans    &trans     &trans                   &trans                                                                                              &trans  &trans  &trans  &trans  &trans    &trans
&trans    &kp A   &kp S     &kp D      &kp F                    &trans                                                                                              &trans  &kp J   &kp K   &kp L   &kp SEMI  &trans
&kp LGUI  &trans  &trans    &trans     &trans                   &trans  &trans     &trans     &trans          &trans  &trans  &trans  &trans  &trans  &trans  &trans  &trans  &trans
&none     &none   &kp BSPC  &kp SPACE  &lt LAYER_SymbolNav DEL          &kp LSHFT  &kp LCTRL  &mt LALT RET    &trans  &trans  &trans          &trans  &trans  &trans  &trans  &trans
            >;
        };

        layer_SymbolNav {
            bindings = <
&trans     &trans         &trans        &trans        &trans                                                                                                                                &trans         &trans         &trans       &trans       &trans
&kp INS    &kp F1         &kp F2        &kp F3        &kp F4       &kp F5                                                                                                       &kp F6      &kp F7         &kp F8         &kp F9       &kp F10      &kp F11
&kp SLCK   &kp GRAVE      &kp LBKT      &kp RBKT      &kp LS(N5)   &none                                                                                                        &kp LS(N7)  &kp LS(EQUAL)  &kp MINUS      &kp LS(N8)   &kp BSLH     &kp F12
&kp PSCRN  &kp LS(N2)     &kp LS(N9)    &kp LS(N0)    &kp LS(SQT)  &kp LS(N3)                                                                                                   &kp LEFT    &kp DOWN       &kp UP         &kp RIGHT    &kp LS(BSLH) &none
&none      &kp LS(GRAVE)  &kp LS(LBKT)  &kp LS(RBKT)  &kp LS(N1)   &none       &trans  &trans   &trans    &trans  &trans  &trans  &kp EQUAL   &kp LS(N6)     &kp LS(COMMA)  &kp LS(DOT)  &kp LS(N4)  &none
&trans     &trans         &trans        &trans        &trans                   &trans  &kp DEL  &trans    &trans  &trans  &trans              &trans         &trans         &trans       &trans      &trans
            >;
        };

        layer_Keypad {
            bindings = <
&none  &none  &none  &none  &none                                                                                                                     &none       &none          &none            &none         &none
&none  &none  &none  &none  &none  &none                                                                                                  &none       &none       &none          &none            &none         &none
&none  &none  &none  &none  &none  &none                                                                                                  &kp KP_N7   &kp KP_N8   &kp KP_N9      &kp KP_MINUS     &kp KP_SLASH  &none
&none  &none  &none  &none  &none  &none                                                                                                  &kp KP_N4   &kp KP_N5   &kp KP_N6      &kp KP_PLUS      &kp KP_MULTIPLY &kp KP_NUM
&none  &none  &none  &none  &none  &none  &trans  &trans  &trans    &trans  &trans  &trans     &kp KP_N1  &kp KP_N2   &kp KP_N3           &kp KP_ENTER &kp KP_EQUAL &tog LAYER_Keypad
&none  &none  &none  &none  &none         &trans  &trans  &trans    &trans  &trans  &kp KP_N0             &kp KP_N0   &kp KP_DOT          &kp BSPC     &none        &none
            >;
        };

        layer_NumRow {
            bindings = <
&trans  &trans  &trans  &trans  &trans                                                                                                            &trans  &trans  &trans  &trans  &trans
&trans  &none   &none   &none   &none   &none                                                                                             &none   &none   &none   &none   &none   &trans
&trans  &none   &none   &none   &none   &none                                                                                             &none   &none   &none   &none   &none   &trans
&trans  &kp N1  &kp N2  &kp N3  &kp N4  &kp N5                                                                                            &kp N6  &kp N7  &kp N8  &kp N9  &kp N0  &trans
&trans  &none   &none   &none   &none   &none   &trans  &trans  &trans    &trans  &trans  &trans  &none   &none   &trans  &trans  &trans  &trans
&trans  &trans  &trans  &trans  &trans          &trans  &trans  &trans    &trans  &trans  &trans          &trans  &trans  &trans  &trans  &trans
            >;
        };

        layer_Magic {
            bindings = <
&none        &none            &none            &none            &none                                                                                                                                      &none         &none         &none         &none   &none
&none        &none            &none            &none            &none            &none                                                                                                              &none  &none         &none         &none         &none   &bt BT_CLR_ALL
&bootloader  &rgb_ug RGB_SPI  &rgb_ug RGB_SAI  &rgb_ug RGB_HUI  &rgb_ug RGB_BRI  &rgb_ug RGB_TOG                                                                                                    &none  &kp C_MUTE    &kp C_VOL_DN  &kp C_VOL_UP  &none   &bootloader
&sys_reset   &rgb_ug RGB_SPD  &rgb_ug RGB_SAD  &rgb_ug RGB_HUD  &rgb_ug RGB_BRD  &rgb_ug RGB_EFF                                                                                                    &none  &kp C_PREV    &kp C_NEXT    &kp C_PP      &none   &sys_reset
&bt BT_CLR   &none            &bt_0            &bt_1            &bt_2            &bt_3            &none              &none          &none    &none  &none  &none  &none  &kp C_BRI_DN  &kp C_BRI_UP  &none  &none         &to LAYER_Factory
&none        &none            &out OUT_USB     &none            &none                             &tog LAYER_Gaming  &tog LAYER_PC  &none    &none  &none  &none         &none         &none         &none  &none         &none
            >;
        };

        layer_Factory {
            bindings = <
&kp NUMBER_0  &kp NUMBER_6  &kp NUMBER_2  &kp NUMBER_8  &kp NUMBER_4                                                                                                                    &kp NUMBER_4  &kp NUMBER_8  &kp NUMBER_2  &kp NUMBER_6  &kp NUMBER_0
&kp NUMBER_1  &kp NUMBER_7  &kp NUMBER_3  &kp NUMBER_9  &kp NUMBER_5  &kp NUMBER_0                                                                                        &kp NUMBER_0  &kp NUMBER_5  &kp NUMBER_9  &kp NUMBER_3  &kp NUMBER_7  &kp NUMBER_1
&kp NUMBER_2  &kp NUMBER_8  &kp NUMBER_4  &kp NUMBER_0  &kp NUMBER_6  &kp NUMBER_1                                                                                        &kp NUMBER_1  &kp NUMBER_6  &kp NUMBER_0  &kp NUMBER_4  &kp NUMBER_8  &kp NUMBER_2
&kp NUMBER_3  &kp NUMBER_9  &kp NUMBER_5  &kp NUMBER_1  &kp NUMBER_7  &kp NUMBER_2                                                                                        &kp NUMBER_2  &kp NUMBER_7  &kp NUMBER_1  &kp NUMBER_5  &kp NUMBER_9  &kp NUMBER_3
&kp NUMBER_4  &kp NUMBER_0  &kp NUMBER_6  &kp NUMBER_2  &kp NUMBER_8  &kp NUMBER_3  &kp NUMBER_4  &kp NUMBER_5  &kp NUMBER_6    &kp NUMBER_6  &kp NUMBER_5  &kp NUMBER_4  &kp NUMBER_3  &kp NUMBER_8  &kp NUMBER_2  &kp NUMBER_6  &kp NUMBER_0  &kp NUMBER_4
&kp NUMBER_5  &kp NUMBER_1  &kp NUMBER_7  &kp NUMBER_3  &kp NUMBER_9                &kp NUMBER_7  &kp NUMBER_8  &kp NUMBER_9    &kp NUMBER_9  &kp NUMBER_8  &kp NUMBER_7                &kp NUMBER_9  &kp NUMBER_3  &kp NUMBER_7  &kp NUMBER_1  &kp NUMBER_5
            >;
        };

        layer_Mouse {
            bindings = <
&trans  &trans              &trans      &trans      &trans                                                                                                    &trans          &trans          &trans        &trans           &trans
&trans  &trans              &trans      &trans      &trans      &trans                                                                                &trans  &trans          &trans          &trans        &trans           &trans
&trans  &trans              &mkp MB4    &mkp MB5    &trans      &trans                                                                                &msc SCRL_LEFT  &msc SCRL_DOWN  &msc SCRL_UP  &msc SCRL_RIGHT  &trans  &trans
&trans  &mo LAYER_Sniper    &mkp MCLK   &mkp RCLK   &mkp LCLK   &trans                                                                                &kp LEFT        &kp DOWN        &kp UP        &kp RIGHT        &trans  &trans
&trans  &trans              &trans      &trans      &trans      &trans  &trans  &trans  &trans    &trans    &kp ESC    &trans  &mmv MOVE_LEFT  &mmv MOVE_DOWN  &mmv MOVE_UP  &mmv MOVE_RIGHT  &trans           &trans
&trans  &trans              &trans      &trans      &trans              &trans  &trans  &trans    &mkp MCLK &mkp RCLK  &mkp LCLK               &trans          &trans        &trans           &trans           &trans
            >;
        };

        layer_Sniper {
            bindings = <
&trans  &trans  &trans  &trans  &trans                                                                                                                                &trans                 &trans                 &trans               &trans                  &trans
&trans  &trans  &trans  &trans  &trans  &trans                                                                                                &trans                  &trans                 &trans                 &trans               &trans                  &trans
&trans  &trans  &trans  &trans  &trans  &trans                                                                                                &msc SNIPER_SCRL_LEFT   &msc SNIPER_SCRL_DOWN  &msc SNIPER_SCRL_UP  &msc SNIPER_SCRL_RIGHT  &trans  &trans
&trans  &trans  &trans  &trans  &trans  &trans                                                                                                &trans                  &trans                 &trans                 &trans                  &trans  &trans
&trans  &trans  &trans  &trans  &trans  &trans  &trans  &trans  &trans    &trans  &trans  &trans  &mmv SNIPER_MOVE_LEFT  &mmv SNIPER_MOVE_DOWN  &mmv SNIPER_MOVE_UP   &mmv SNIPER_MOVE_RIGHT  &trans  &trans
&trans  &trans  &trans  &trans  &trans          &trans  &trans  &trans    &trans  &trans  &trans                         &trans                 &trans                &trans                  &trans  &trans
            >;
        };
    };
};

/* Per-key RGB Layer Color Helpers */
#define ___ &ug 0x000000
#define GRN &ug 0x00FF00  /* Numbers & Layer Toggles */
#define MAG &ug 0xFF00FF  /* Vim Arrows (HJKL) & Mouse Movement */
#define GLD &ug 0xFFBF00  /* Brackets, Quotes, Scroll & RGB Controls */
#define ORG &ug 0xFF5500  /* Symbols, Math Operators, Clicks & Gaming Mods */
#define CYN &ug 0x00FFFF  /* Function Keys (F1-F12) & Media Controls */
#define RED &ug 0xFF0000  /* System / Lock / Exit / WASD */
#define BLU &ug 0x0066FF  /* PC & Bluetooth / Connectivity */
#define NML &ug_nl 0x00FF00 0xFF0000  /* NumLock indicator (Green=ON, Red=OFF) */

/ {
    underglow-layer {
        compatible = "zmk,underglow-layer";

        /* Permanent layer: lights up for 3s when toggled on, then fades out */
        layer_PC {
            layer-id = <LAYER_PC>;
            fade-delay = <3>;
            bindings = <
 ___  ___  ___  ___  ___                                                                                      ___  ___  ___  ___  ___
 ___  ___  ___  ___  ___  ___                                                                            ___  ___  ___  ___  ___  ___
 ___  ___  ___  ___  ___  ___                                                                            ___  ___  ___  ___  ___  ___
 ___  BLU  BLU  BLU  BLU  ___                                                                            ___  BLU  BLU  BLU  BLU  ___
 ___  ___  ___  ___  ___  ___  ___  ___  ___      ___  ___  ___      ___  ___  ___  ___  ___  ___
 ___  BLU  BLU  BLU  BLU       ___  ___  ___      ___  ___  ___           ___  ___  ___  ___  ___
            >;
        };

        /* Permanent layer: lights up for 3s when toggled on, then fades out */
        layer_Gaming {
            layer-id = <LAYER_Gaming>;
            fade-delay = <3>;
            bindings = <
 ___  ___  ___  ___  ___                                                                                      ___  ___  ___  ___  ___
 ___  ___  ___  ___  ___  ___                                                                            ___  ___  ___  ___  ___  ___
 ORG  ___  RED  ___  ___  ___                                                                            ___  ___  ___  ___  ___  ___
 ___  RED  RED  RED  ORG  ___                                                                            ___  ORG  ORG  ORG  ORG  ___
 ORG  ___  ___  ___  ___  ___  ___  ___  ___      ___  ___  ___      ___  ___  ___  ___  ___  ___
 ___  ___  ORG  ORG  GRN       ORG  ORG  ORG      ___  ___  ___           ___  ___  ___  ___  ___
            >;
        };

        /* Momentary layer: stays lit while held */
        layer_SymbolNav {
            layer-id = <LAYER_SymbolNav>;
            bindings = <
 ___  ___  ___  ___  ___                                                                                      ___  ___  ___  ___  ___
 RED  CYN  CYN  CYN  CYN  CYN                                                                            CYN  CYN  CYN  CYN  CYN  CYN
 RED  ORG  GLD  GLD  ORG  ___                                                                            ORG  ORG  ORG  ORG  ORG  CYN
 RED  ORG  GLD  GLD  GLD  ORG                                                                            MAG  MAG  MAG  MAG  ORG  ___
 ___  ORG  GLD  GLD  ORG  ___  ___  ___  ___      ___  ___  ___      ORG  ORG  ORG  ORG  ORG  ___
 ___  ___  ___  ___  ___       ___  RED  ___      ___  ___  ___           ___  ___  ___  ___  ___
            >;
        };

        /* Hybrid layer: stays lit while active (both held and double-tap toggled) */
        layer_Keypad {
            layer-id = <LAYER_Keypad>;
            bindings = <
 ___  ___  ___  ___  ___                                                                                      ___  ___  ___  ___  ___
 ___  ___  ___  ___  ___  ___                                                                            ___  ___  ___  ___  ___  ___
 ___  ___  ___  ___  ___  ___                                                                            GRN  GRN  GRN  ORG  ORG  ___
 ___  ___  ___  ___  ___  ___                                                                            GRN  GRN  GRN  ORG  ORG  NML
 ___  ___  ___  ___  ___  ___  ___  ___  ___      ___  ___  ___      GRN  GRN  GRN  ORG  ORG  RED
 ___  ___  ___  ___  ___       ___  ___  ___      ___  ___  GRN           GRN  GRN  ORG  ___  ___
            >;
        };

        /* Momentary layer: stays lit while held */
        layer_NumRow {
            layer-id = <LAYER_NumRow>;
            bindings = <
 ___  ___  ___  ___  ___                                                                                      ___  ___  ___  ___  ___
 ___  ___  ___  ___  ___  ___                                                                            ___  ___  ___  ___  ___  ___
 ___  ___  ___  ___  ___  ___                                                                            ___  ___  ___  ___  ___  ___
 ___  GRN  GRN  GRN  GRN  GRN                                                                            GRN  GRN  GRN  GRN  GRN  ___
 ___  ___  ___  ___  ___  ___  ___  ___  ___      ___  ___  ___      ___  ___  ___  ___  ___  ___
 ___  ___  ___  ___  ___       ___  ___  ___      ___  ___  ___           ___  ___  ___  ___  ___
            >;
        };

        /* Momentary layer: stays lit while held */
        layer_Magic {
            layer-id = <LAYER_Magic>;
            bindings = <
 ___  ___  ___  ___  ___                                                                                      ___  ___  ___  ___  ___
 ___  ___  ___  ___  ___  ___                                                                            ___  ___  ___  ___  ___  RED
 RED  GLD  GLD  GLD  GLD  GLD                                                                            ___  CYN  CYN  CYN  ___  RED
 RED  GLD  GLD  GLD  GLD  GLD                                                                            ___  CYN  CYN  CYN  ___  RED
 RED  ___  BLU  BLU  BLU  BLU  ___  ___  ___      ___  ___  ___      ___  CYN  CYN  ___  ___  RED
 ___  ___  BLU  ___  ___       GRN  GRN  ___      ___  ___  ___           ___  ___  ___  ___  ___
            >;
        };

        /* Momentary layer: stays lit while held */
        layer_Mouse {
            layer-id = <LAYER_Mouse>;
            bindings = <
 ___  ___  ___  ___  ___                                                                                      ___  ___  ___  ___  ___
 ___  ___  ___  ___  ___  ___                                                                            ___  ___  ___  ___  ___  ___
 ___  ___  ORG  ORG  ___  ___                                                                            GLD  GLD  GLD  GLD  ___  ___
 ___  GRN  ORG  ORG  ORG  ___                                                                            CYN  CYN  CYN  CYN  ___  ___
 ___  ___  ___  ___  ___  ___  ___  ___  ___      ___  RED  ___      MAG  MAG  MAG  MAG  ___  ___
 ___  ___  ___  ___  ___       ___  ___  ___      ORG  ORG  ORG           ___  ___  ___  ___  ___
            >;
        };

        /* Momentary layer: stays lit while held */
        layer_Sniper {
            layer-id = <LAYER_Sniper>;
            bindings = <
 ___  ___  ___  ___  ___                                                                                      ___  ___  ___  ___  ___
 ___  ___  ___  ___  ___  ___                                                                            ___  ___  ___  ___  ___  ___
 ___  ___  ___  ___  ___  ___                                                                            GLD  GLD  GLD  GLD  ___  ___
 ___  ___  ___  ___  ___  ___                                                                            ___  ___  ___  ___  ___  ___
 ___  ___  ___  ___  ___  ___  ___  ___  ___      ___  ___  ___      RED  RED  RED  RED  ___  ___
 ___  ___  ___  ___  ___       ___  ___  ___      ___  ___  ___           ___  ___  ___  ___  ___
            >;
        };
    };
};
